## base_external/package/application-code/Config.in
```kconfig
config BR2_PACKAGE_APPLICATION_CODE
	bool "application-code"
	help
	  Includes the writer executable, finder.sh and tester.sh in the kernel image.
	  Used to understand buildroot external trees and package builds.
```
